#include <WiFi.h>
#include <WebServer.h>
#include <IRremote.h>
#include <time.h>
#include <ArduinoJson.h>
#include <Preferences.h>
#include <Wire.h>
#include <RTClib.h>

#define IR_LED_PIN 4
#define BUZZER_PIN 5

Preferences preferences;
RTC_DS3231 rtc;
bool isAPMode = false;

// Non-blocking buzzer state
unsigned long buzzerStartTime = 0;
unsigned long buzzerDuration = 0;
int buzzerPatternCount = 0;
unsigned long nextBeepTime = 0;
bool buzzerActive = false;

// ================= WIFI =================
const char* ssid = "Elconics";
const char* password = "Elconics@123";

WebServer server(80);

// ================= SCHEDULER DATA =================
uint8_t schedule[7][24]; // 7 days (0=Sun, 6=Sat), 24 hours
int lastFiredHour = -1;
int lastFiredDay = -1;
bool forceCheck = false; // Flag to trigger immediate schedule check
int activeTemp = 0;    // Currently set temperature
bool acPower = false;  // Current power state

// ================= NTP CONFIG =================
const char* ntpServer = "pool.ntp.org";
const long gmtOffset_sec = 19800; // +5:30 (19800 seconds)
const int daylightOffset_sec = 0;

// ================= IR RAW DATA =================
// KEEP YOUR EXISTING RAW ARRAYS HERE

// Example:
uint16_t powerOn[] = {
 1000, 600, 1000, 600, 1000, 2550, 1000, 2600, 950, 650, 950, 2600,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 900

};

// ====== POWER OFF ======
uint16_t powerOff[] = {
 1000, 600, 1000, 600, 1000, 2550, 1000, 2600, 1000, 600, 1000, 2550,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 950

};
// temp 24-30 is with fan
// ====== TEMP + ======
uint16_t temp16[] = { 1000, 600, 1000, 600, 1000, 2600, 1000, 2550, 950, 650, 950, 2600, 1000,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 700, 900 };
uint16_t temp17[] = {1050, 550, 1050, 550, 1050, 2550, 1000, 2550, 1050, 550, 1050, 2500, 1050,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 2650, 950 };
uint16_t temp18[] = { 1000, 650, 950, 650, 950, 2600, 1000, 2550, 1000, 600, 1000, 2600, 950,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 700, 900};
uint16_t temp19[] = { 1050, 550, 1000, 600, 1050, 2550, 1000, 2550, 1000, 600, 1000, 2550, 1000,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 650, 950};
uint16_t temp20[] = { 1050, 500, 1100, 500, 1100, 2500, 1050, 2500, 1050, 550, 1050, 2550, 1050,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 650, 950};
uint16_t temp21[] = { 1000, 650, 950, 650, 950, 2600, 1000, 2550, 1000, 600, 1000, 2550, 1000,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 700, 900};
uint16_t temp22[] = { 1000, 600, 1000, 600, 1000, 2600, 950, 2600, 950, 650, 950, 2600, 1000,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 650, 950 };
uint16_t temp23[] = { 1050, 550, 1000, 600, 1000, 2600, 950, 2600, 1000, 600, 1000, 2550, 1000,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 650, 950 };
uint16_t temp24[] = { 1050, 550, 1050, 550, 1050, 2550, 1050, 2500, 1050, 550, 1050, 2550, 1000,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 2600, 950 };
uint16_t temp25[] = {1050, 550, 1050, 550, 1050, 2550, 1000, 2550, 1000, 600, 1050, 2500, 1050,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 2650, 950 };
uint16_t temp26[] = { 1050, 550, 1100, 500, 1050, 2500, 1100, 2500, 1050, 550, 1050, 2500, 1050,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 2650, 950 };
uint16_t temp27[] = { 1050, 550, 1050, 550, 1050, 2550, 1050, 2500, 1050, 550, 1050, 2500, 1050,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 2600, 950 };
uint16_t temp28[] = {1050, 550, 1050, 550, 1050, 2550, 1050, 2500, 1050, 550, 1050, 2500, 1050,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 2650, 950 };
uint16_t temp29[] = { 1050, 550, 1050, 550, 1050, 2500, 1050, 2500, 1100, 500, 1100, 2500, 1050,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 2600, 950 };
uint16_t temp30[] = { 1050, 550, 1050, 550, 1050, 2500, 1050, 2500, 1100, 500, 1100, 2500, 1050,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 2600, 950 };


// ================= HTML PAGE =================
String webpage = R"rawliteral(
<!DOCTYPE html>
<html lang="en">
<head>
    <meta charset="UTF-8">
    <meta name="viewport" content="width=device-width, initial-scale=1.0">
    <title>Smart AC Controller</title>
    <style>
        :root {
            --primary: #00f2fe;
            --secondary: #4facfe;
            --bg: #0f172a;
            --card: #1e293b;
            --text: #f8fafc;
        }
        body {
            font-family: 'Segoe UI', Tahoma, Geneva, Verdana, sans-serif;
            background-color: var(--bg);
            color: var(--text);
            margin: 0;
            display: flex;
            flex-direction: column;
            align-items: center;
            min-height: 100vh;
        }
        .container {
            width: 95%;
            max-width: 1200px;
            padding: 20px;
        }
        .card {
            background: var(--card);
            border-radius: 15px;
            padding: 20px;
            box-shadow: 0 10px 25px rgba(0,0,0,0.3);
            margin-bottom: 20px;
        }
        h1 { text-align: center; background: linear-gradient(to right, var(--primary), var(--secondary)); -webkit-background-clip: text; -webkit-text-fill-color: transparent; }
        .tabs { display: flex; justify-content: center; margin-bottom: 20px; gap: 10px; }
        .tab { padding: 10px 20px; cursor: pointer; border-radius: 8px; background: #334155; transition: 0.3s; }
        .tab.active { background: var(--secondary); color: white; }
        .tab-content { display: none; }
        .tab-content.active { display: block; }
        
        /* Remote UI */
        .btn-grid { display: grid; grid-template-columns: repeat(auto-fit, minmax(80px, 1fr)); gap: 10px; }
        button { padding: 15px; border: none; border-radius: 10px; font-weight: bold; cursor: pointer; transition: 0.2s; }
        button:active { transform: scale(0.95); }
        .btn-on { background: #22c55e; color: white; }
        .btn-off { background: #ef4444; color: white; }
        .btn-temp { background: #3b82f6; color: white; border: 2px solid transparent; }
        .btn-temp.active { border-color: var(--primary); box-shadow: 0 0 15px var(--primary); transform: scale(1.05); }
        .cell.current-slot { border: 2px solid #fbbf24 !important; background: rgba(251, 191, 36, 0.4) !important; box-shadow: inset 0 0 10px #fbbf24; z-index: 10; position: relative; }
        .active-status { background: #334155; padding: 10px; border-radius: 10px; margin-bottom: 15px; display: flex; justify-content: space-around; font-weight: bold; }
        .status-val { color: var(--primary); }
        
        /* Scheduler UI */
        .sched-controls { display: flex; flex-wrap: wrap; gap: 15px; margin-bottom: 15px; align-items: center; background: #334155; padding: 15px; border-radius: 10px; }
        .sched-grid-container { overflow-x: auto; }
        table { width: 100%; border-collapse: collapse; min-width: 800px; }
        th, td { border: 1px solid #475569; text-align: center; padding: 5px; font-size: 12px; }
        .cell { width: 30px; height: 30px; cursor: pointer; transition: 0.2s; }
        .cell:hover { background: #475569; }
        .day-label { font-weight: bold; width: 50px; }
        
        .status-bar { position: fixed; bottom: 20px; right: 20px; padding: 10px 20px; border-radius: 20px; background: var(--secondary); display: none; }
    </style>
</head>
<body>
    <div class="container">
        <h1>Lloyd AC Smart Hub</h1>
        
        <div class="tabs">
            <div class="tab active" onclick="showTab('remote')">Remote</div>
            <div class="tab" onclick="showTab('scheduler')">Scheduler</div>
        </div>

        <!-- Remote Tab -->
        <div id="remote" class="tab-content active">
            <div class="card">
                <h3>Power</h3>
                <div class="btn-grid">
                    <button class="btn-on" onclick="cmd('/on')">ON</button>
                    <button class="btn-off" onclick="cmd('/off')">OFF</button>
                </div>
            </div>
            <div class="active-status">
                <div>Time: <span id="stat-time" class="status-val">--:--</span></div>
                <div>Power: <span id="stat-power" class="status-val">OFF</span></div>
                <div>Setting: <span id="stat-temp" class="status-val">--</span></div>
            </div>
            <div class="card">
                <h3>Temperature</h3>
                <div class="btn-grid" id="temp-btns"></div>
            </div>
        </div>

        <!-- Scheduler Tab -->
        <div id="scheduler" class="tab-content">
            <div class="card">
                <div class="sched-controls">
                    <div>
                        Temp: <select id="sel-temp">
                            <option value="0">No Action</option>
                            <option value="1">OFF</option>
                            <option value="16">16°C</option><option value="17">17°C</option><option value="18">18°C</option>
                            <option value="19">19°C</option><option value="20">20°C</option><option value="21">21°C</option>
                            <option value="22">22°C</option><option value="23">23°C</option><option value="24">24°C</option>
                            <option value="25">25°C</option><option value="26">26°C</option><option value="27">27°C</option>
                            <option value="28">28°C</option><option value="29">29°C</option><option value="30">30°C</option>
                        </select>
                    </div>
                    <div>
                        Slot: <select id="sel-slot">
                            <option value="1">1 Hour</option>
                            <option value="4">4 Hours</option>
                            <option value="6">6 Hours</option>
                            <option value="12">12 Hours</option>
                            <option value="24">24 Hours (Full Day)</option>
                        </select>
                    </div>
                    <button class="btn-temp" onclick="saveSchedule()">Save Schedule</button>
                    <button style="background:#64748b" onclick="loadSchedule()">Reload</button>
                </div>
                
                <div class="sched-grid-container">
                    <table id="sched-table">
                        <thead>
                            <tr><th>Day</th><script>for(let i=0;i<24;i++) document.write(`<th>${i}h</th>`);</script></tr>
                        </thead>
                        <tbody id="sched-body"></tbody>
                    </table>
                </div>
            </div>
        </div>
    </div>

    <div id="status" class="status-bar"></div>

    <script>
        const days = ["Sun", "Mon", "Tue", "Wed", "Thu", "Fri", "Sat"];
        let schedule = Array(7).fill().map(() => Array(24).fill(0));
        let deviceId = "";

        // Build Temp Buttons
        const tGrid = document.getElementById('temp-btns');
        for(let i=16; i<=30; i++) {
            tGrid.innerHTML += `<button class="btn-temp" id="tbtn-${i}" onclick="cmd('/temp?value=${i}')">${i}°</button>`;
        }

        // Build Grid
        const sBody = document.getElementById('sched-body');
        days.forEach((day, dIdx) => {
            let row = `<tr><td class="day-label">${day}</td>`;
            for(let h=0; h<24; h++) {
                row += `<td class="cell" id="c-${dIdx}-${h}" onclick="fillSlot(${dIdx}, ${h})">--</td>`;
            }
            row += `</tr>`;
            sBody.innerHTML += row;
        });

        function showTab(id) {
            document.querySelectorAll('.tab-content').forEach(t => t.classList.remove('active'));
            document.querySelectorAll('.tab').forEach(t => t.classList.remove('active'));
            document.getElementById(id).classList.add('active');
            event.currentTarget.classList.add('active');
            if(id === 'scheduler') loadSchedule();
        }

        function cmd(url) {
            notify("Sending Command...");
            fetch(url).then(r => r.text()).then(t => {
                notify(t);
                setTimeout(loadSchedule, 500); // Refresh UI after command
            });
        }

        function notify(msg) {
            const s = document.getElementById('status');
            s.innerText = msg; s.style.display = 'block';
            setTimeout(() => s.style.display = 'none', 3000);
        }

        function fillSlot(d, h) {
            const temp = parseInt(document.getElementById('sel-temp').value);
            const slot = parseInt(document.getElementById('sel-slot').value);
            for(let i=0; i<slot; i++) {
                let currentH = (h + i) % 24;
                let currentD = d + Math.floor((h + i) / 24);
                if(currentD < 7) {
                    schedule[currentD][currentH] = temp;
                    updateCellUI(currentD, currentH);
                }
            }
        }

        function updateCellUI(d, h) {
            const cell = document.getElementById(`c-${d}-${h}`);
            const val = schedule[d][h];
            cell.innerText = val === 0 ? '--' : (val === 1 ? 'OFF' : val + '°');
            cell.style.background = val > 1 ? `rgba(59, 130, 246, ${0.2 + (val-16)/20})` : (val === 1 ? 'rgba(239, 68, 68, 0.3)' : 'transparent');
        }

        function loadSchedule() {
            fetch('/schedule').then(r => r.json()).then(data => {
                schedule = data.schedule;
                deviceId = data.device_id;
                
                // Update Status UI
                document.getElementById('stat-power').innerText = data.power ? "ON" : "OFF";
                document.getElementById('stat-temp').innerText = data.temp > 1 ? data.temp + "°C" : (data.temp === 1 ? "OFF" : "--");
                document.getElementById('stat-time').innerText = `${String(data.hour).padStart(2,'0')}:${String(data.min).padStart(2,'0')}`;
                
                // Highlight active button
                document.querySelectorAll('.btn-temp').forEach(b => b.classList.remove('active'));
                if(data.temp >= 16) {
                    const activeBtn = document.getElementById(`tbtn-${data.temp}`);
                    if(activeBtn) activeBtn.classList.add('active');
                }

                // Highlight current time slot in yellow
                document.querySelectorAll('.cell').forEach(c => c.classList.remove('current-slot'));
                const currentCell = document.getElementById(`c-${data.day}-${data.hour}`);
                if(currentCell) currentCell.classList.add('current-slot');

                for(let d=0; d<7; d++) for(let h=0; h<24; h++) updateCellUI(d, h);
                notify("UI Synced");
            });
        }

        // Auto-refresh every 30 seconds to sync scheduler events
        setInterval(loadSchedule, 30000);

        function saveSchedule() {
            notify("Saving...");
            fetch('/schedule', {
                method: 'POST',
                headers: {'Content-Type': 'application/json'},
                body: JSON.stringify({ device_id: deviceId, schedule: schedule })
            }).then(r => r.text()).then(t => notify(t));
        }
    </script>
</body>
</html>
)rawliteral";

// ================= NVS STORAGE =================

void saveScheduleToNVS() {
  preferences.begin("ac-sched", false);
  preferences.putBytes("schedule", schedule, sizeof(schedule));
  preferences.end();
  Serial.println("Schedule saved to NVS");
}

void loadScheduleFromNVS() {
  preferences.begin("ac-sched", true);
  size_t schLen = preferences.getBytesLength("schedule");
  if (schLen == sizeof(schedule)) {
    preferences.getBytes("schedule", schedule, sizeof(schedule));
    Serial.println("Schedule loaded from NVS");
  } else {
    Serial.println("No valid schedule found in NVS, initializing with 0");
    for (int i = 0; i < 7; i++) {
      for (int j = 0; j < 24; j++) {
        schedule[i][j] = 0;
      }
    }
  }
  preferences.end();
}

// ================= NON-BLOCKING BUZZER =================
void startBeep(unsigned long duration, int pattern = 1) {
  buzzerDuration = duration;
  buzzerPatternCount = pattern;
  buzzerStartTime = millis();
  nextBeepTime = millis();
  buzzerActive = true;
}

void updateBuzzer() {
  if (!buzzerActive) return;

  unsigned long now = millis();
  if (now >= nextBeepTime) {
    if (digitalRead(BUZZER_PIN) == LOW) {
      // Start a beep
      digitalWrite(BUZZER_PIN, HIGH);
      nextBeepTime = now + buzzerDuration;
    } else {
      // End a beep
      digitalWrite(BUZZER_PIN, LOW);
      buzzerPatternCount--;
      if (buzzerPatternCount <= 0) {
        buzzerActive = false;
      } else {
        nextBeepTime = now + buzzerDuration; // Gap between beeps
      }
    }
  }
}

void beepShort() { startBeep(100, 1); }
void beepSave() { startBeep(80, 2); }
void beepAP() { startBeep(50, 3); }
void beepWiFiConnected() { startBeep(100, 2); }

// ================= IR SEND FUNCTIONS =================
void sendPowerOn() {
  beepShort();
  Serial.println("Sending Power ON");
  acPower = true;
  IrSender.sendRaw(powerOn, sizeof(powerOn) / sizeof(powerOn[0]), 38);
}

void sendPowerOff() {
  beepShort();
  Serial.println("Sending Power OFF");
  acPower = false;
  activeTemp = 1; // 1 represents OFF state
  IrSender.sendRaw(powerOff, sizeof(powerOff) / sizeof(powerOff[0]), 38);
}

void sendTemperature(int temp) {
  beepShort();
  Serial.print("Sending Temp: ");
  Serial.println(temp);
  activeTemp = temp;
  acPower = true;

  switch(temp) {

    case 16:
      IrSender.sendRaw(temp16, sizeof(temp16)/sizeof(temp16[0]), 38);
      break;

    case 17:
      IrSender.sendRaw(temp17, sizeof(temp17)/sizeof(temp17[0]), 38);
      break;

    case 18:
      IrSender.sendRaw(temp18, sizeof(temp18)/sizeof(temp18[0]), 38);
      break;

    case 19:
      IrSender.sendRaw(temp19, sizeof(temp19)/sizeof(temp19[0]), 38);
      break;

    case 20:
      IrSender.sendRaw(temp20, sizeof(temp20)/sizeof(temp20[0]), 38);
      break;

    case 21:
      IrSender.sendRaw(temp21, sizeof(temp21)/sizeof(temp21[0]), 38);
      break;

    case 22:
      IrSender.sendRaw(temp22, sizeof(temp22)/sizeof(temp22[0]), 38);
      break;

    case 23:
      IrSender.sendRaw(temp23, sizeof(temp23)/sizeof(temp23[0]), 38);
      break;

    case 24:
      IrSender.sendRaw(temp24, sizeof(temp24)/sizeof(temp24[0]), 38);
      break;

    case 25:
      IrSender.sendRaw(temp25, sizeof(temp25)/sizeof(temp25[0]), 38);
      break;

    case 26:
      IrSender.sendRaw(temp26, sizeof(temp26)/sizeof(temp26[0]), 38);
      break;

    case 27:
      IrSender.sendRaw(temp27, sizeof(temp27)/sizeof(temp27[0]), 38);
      break;

    case 28:
      IrSender.sendRaw(temp28, sizeof(temp28)/sizeof(temp28[0]), 38);
      break;

    case 29:
      IrSender.sendRaw(temp29, sizeof(temp29)/sizeof(temp29[0]), 38);
      break;

    case 30:
      IrSender.sendRaw(temp30, sizeof(temp30)/sizeof(temp30[0]), 38);
      break;
  }
}

// ================= SETUP =================

void setup() {

  Serial.begin(115200);

  IrSender.begin(IR_LED_PIN);
  pinMode(BUZZER_PIN, OUTPUT);
  digitalWrite(BUZZER_PIN, LOW);

  // RTC Init
  if (!rtc.begin()) {
    Serial.println("Couldn't find RTC");
  }

  // WIFI CONNECT with stability fixes
  WiFi.disconnect(true); // Clear previous settings
  delay(100);
  WiFi.mode(WIFI_STA);   // Explicitly set Station mode
  WiFi.setSleep(false);  // Disable power saving for better stability
  
  WiFi.begin(ssid, password);
  Serial.println();
  Serial.print("Connecting to WiFi");
  
  unsigned long startAttemptTime = millis();
  while (WiFi.status() != WL_CONNECTED && millis() - startAttemptTime < 10000) {
    delay(500);
    Serial.print(".");
  }

  if (WiFi.status() == WL_CONNECTED) {
    Serial.println("\nWiFi Connected");
    Serial.print("IP Address: ");
    Serial.println(WiFi.localIP());
    beepWiFiConnected(); // Double beep for Online

    // NTP Sync
    configTime(gmtOffset_sec, daylightOffset_sec, ntpServer);
    Serial.println("Waiting for NTP sync...");
    struct tm timeinfo;
    if (getLocalTime(&timeinfo)) {
      Serial.println("Time synced from NTP");
      // Update RTC with NTP time
      rtc.adjust(DateTime(timeinfo.tm_year + 1900, timeinfo.tm_mon + 1, timeinfo.tm_mday, 
                          timeinfo.tm_hour, timeinfo.tm_min, timeinfo.tm_sec));
      Serial.println("RTC updated from NTP");
    }
  } else {
    Serial.println("\nWiFi failed. Starting Access Point Mode...");
    WiFi.softAP("Smart-AC-Hub", "12345678");
    isAPMode = true;
    beepAP(); // Triple beep for AP Mode
    Serial.print("AP IP Address: ");
    Serial.println(WiFi.softAPIP());
  }

  // Load schedule from NVS (replaces manual initialization)
  loadScheduleFromNVS();

  // ================= WEB ROUTES =================

  server.on("/", []() {

    server.send(200, "text/html", webpage);

  });

  server.on("/on", []() {
    server.send(200, "text/plain", "AC POWER ON");
    sendPowerOn();
  });

  server.on("/off", []() {
    server.send(200, "text/plain", "AC POWER OFF");
    sendPowerOff();
  });

  server.on("/temp", []() {
    if(server.hasArg("value")) {
      int temp = server.arg("value").toInt();
      if(temp >= 16 && temp <= 30) {
        server.send(200, "text/plain", "Temperature Set To " + String(temp) + " C");
        sendTemperature(temp);
      }
      else {
        server.send(400, "text/plain", "Invalid Temperature");
      }
    } else {
      server.send(400, "text/plain", "Temperature Missing");
    }
  });

  server.on("/schedule", HTTP_GET, []() {
    StaticJsonDocument<4096> doc;
    doc["device_id"] = WiFi.macAddress();
    doc["temp"] = activeTemp;
    doc["power"] = acPower;
    
    struct tm timeinfo;
    bool timeValid = false;
    if (getLocalTime(&timeinfo)) {
      timeValid = true;
    } else {
      DateTime now = rtc.now();
      timeinfo.tm_hour = now.hour();
      timeinfo.tm_min = now.minute();
      timeinfo.tm_wday = now.dayOfTheWeek();
      timeValid = true;
    }

    if (timeValid) {
      doc["hour"] = timeinfo.tm_hour;
      doc["min"] = timeinfo.tm_min;
      doc["day"] = timeinfo.tm_wday;
    } else {
      doc["hour"] = 0; doc["min"] = 0; doc["day"] = 0;
    }

    JsonArray schedArr = doc.createNestedArray("schedule");
    for (int i = 0; i < 7; i++) {
      JsonArray dayArr = schedArr.createNestedArray();
      for (int j = 0; j < 24; j++) {
        dayArr.add(schedule[i][j]);
      }
    }
    String response;
    serializeJson(doc, response);
    server.send(200, "application/json", response);
  });

  server.on("/schedule", HTTP_POST, []() {
    if (server.hasArg("plain") == false) {
      server.send(400, "text/plain", "Body not found");
      return;
    }

    StaticJsonDocument<4096> doc;
    DeserializationError error = deserializeJson(doc, server.arg("plain"));

    if (error) {
      server.send(400, "text/plain", "JSON parse failed");
      return;
    }

    // Check device ID
    String receivedId = doc["device_id"];
    if (receivedId != WiFi.macAddress()) {
      server.send(403, "text/plain", "Unauthorized: Device ID mismatch");
      return;
    }

    JsonArray schedArr = doc["schedule"];
    if (schedArr.size() == 7) {
      for (int i = 0; i < 7; i++) {
        JsonArray dayArr = schedArr[i];
        if (dayArr.size() == 24) {
          for (int j = 0; j < 24; j++) {
            schedule[i][j] = dayArr[j];
          }
        }
      }
      saveScheduleToNVS(); // Save to NVS after successful update
      beepSave(); // Buzzer feedback for save
      forceCheck = true; // Trigger immediate check
      server.send(200, "text/plain", "Schedule Updated");
    } else {
      server.send(400, "text/plain", "Invalid schedule format");
    }
  });

  server.begin();

  Serial.println("Web Server Started");
}

// ================= LOOP =================

void loop() {
  server.handleClient();
  updateBuzzer();
  
  static unsigned long lastCheck = 0;
  if (millis() - lastCheck > 10000 || lastCheck == 0 || forceCheck) {
    lastCheck = millis();
    // Use the forceCheck flag to re-trigger if needed
    bool savedForceCheck = forceCheck;
    forceCheck = false; 
    struct tm timeinfo;
    bool hasTime = false;
    
    if (getLocalTime(&timeinfo)) {
      hasTime = true;
    } else {
      // Fallback to RTC
      DateTime now = rtc.now();
      timeinfo.tm_hour = now.hour();
      timeinfo.tm_min = now.minute();
      timeinfo.tm_wday = now.dayOfTheWeek();
      timeinfo.tm_sec = now.second();
      hasTime = true;
      Serial.println("Using RTC time (Offline)");
    }

    if (hasTime) {
      int currentHour = timeinfo.tm_hour;
      int currentDay = timeinfo.tm_wday; // 0=Sun, 6=Sat

      if (currentHour != lastFiredHour || currentDay != lastFiredDay || savedForceCheck) {
        Serial.printf("Applying Schedule: %02d:00 (Day: %d) [%s]\n", 
                      currentHour, currentDay, 
                      WiFi.status() == WL_CONNECTED ? "Online" : "Offline");
        
        uint8_t targetTemp = schedule[currentDay][currentHour];
        Serial.printf("Schedule Check: Day %d, Hour %d -> Target %d\n", currentDay, currentHour, targetTemp);
        
        if (targetTemp >= 16 && targetTemp <= 30) {
          Serial.printf("Scheduled Event: Setting temp to %d\n", targetTemp);
          sendTemperature(targetTemp);
        } else if (targetTemp == 1) { // 1 for Power OFF
           Serial.println("Scheduled Event: AC OFF");
           sendPowerOff();
        }
        lastFiredHour = currentHour;
        lastFiredDay = currentDay;
      }
    } else {
      Serial.println("Failed to obtain time (NTP and RTC failed?)");
    }
  }
}